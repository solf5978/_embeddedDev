## CMakeLists.txt
```
#
# Copyright (c) 2020 Nordic Semiconductor
#
# SPDX-License-Identifier: LicenseRef-Nordic-5-Clause
#

cmake_minimum_required(VERSION 3.20.0)
find_package(Zephyr REQUIRED HINTS $ENV{ZEPHYR_BASE})

project(nrf_connect_sdk_fundamentals)

target_sources(app PRIVATE src/main.c)
target_sources_ifdef(CONFIG_FUNCTEST app PRIVATE src/funcTest.c)
#target_sources(app PRIVATE src/funcTest.c)
```

## Kconfig
```
source "Kconfig.zephyr"

config FUNCTEST
    bool "Enable FUNCTEST"
    default n
```

## prj.conf
```kconfig
#
# Copyright (c) 2020 Nordic Semiconductor
#
# SPDX-License-Identifier: LicenseRef-Nordic-5-Clause
#

CONFIG_FUNCTEST=y
```

## src/main.c
```c
/*
 * Copyright (c) 2022 Nordic Semiconductor ASA
 *
 * SPDX-License-Identifier: LicenseRef-Nordic-5-Clause
 */

#include <zephyr/kernel.h>
#include <zephyr/sys/printk.h>
#ifdef CONFIG_FUNCTEST
#include "funcTest.h"
#endif

void main(void)
{
	#ifdef CONFIG_FUNCTEST
		int a = 3;
		int b = 4;
		printk("Hello World!\n\r");
		printk("Total Sum of %d and %d is %d\n\r", a, b, total_sum(a, b));
	#else
		prinkt("FUNCTEST IS NOT ENABLED\n\r");
		return;
	#endif

	while(1) {
		k_msleep(1000);
	}
}
```

## src/funcTest.c
```c
#include "funcTest.h"

int total_sum(int num1, int num2){
    return num1 + num2;
}
```

## src/funcTest.h
```c
#ifndef FUNCTEST_H
#define FUNCTEST_H

int total_sum(int a, int b);

#endif
```
